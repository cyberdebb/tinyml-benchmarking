#include <algorithm>
#include <cmath>
#include <cstddef>
#include <cstdint>
#include <cstdio>
#include <cstring>

#include "esp_heap_caps.h"
#include "esp_log.h"

#include "tensorflow/lite/micro/micro_interpreter.h"
#include "tensorflow/lite/micro/micro_mutable_op_resolver.h"
#include "tensorflow/lite/schema/schema_generated.h"

#include "beat_features.h"
#include "tinyml_common.h"
#include "tinyml_model.h"

// Generated by the training pipeline. Included ONLY here: it defines the
// model's array, so including it anywhere else would copy the model into
// the flash again.
#include "models/mlp_classifier.h"
#include "models/mlp_classifier_scaler.h"

const char kModelName[] = "MLP";

namespace {

constexpr char TAG[] = "tinyml";

constexpr size_t kArenaSize = 128 * 1024;

uint8_t *tensor_arena = nullptr;
size_t arena_size = 0;
tflite::MicroInterpreter *interpreter = nullptr;
TfLiteTensor *input_tensor = nullptr;
TfLiteTensor *output_tensor = nullptr;

bool allocate_arena()
{
    tensor_arena = static_cast<uint8_t *>(
        heap_caps_malloc(kArenaSize, MALLOC_CAP_INTERNAL | MALLOC_CAP_8BIT));
    if (tensor_arena == nullptr) {
        ESP_LOGE(TAG, "Unable to allocate TFLite tensor arena");
        return false;
    }
    arena_size = kArenaSize;
    ESP_LOGI(TAG, "Tensor arena: %u bytes in internal RAM",
             static_cast<unsigned>(arena_size));
    return true;
}

}

bool init_model()
{
    if (!allocate_arena()) {
        return false;
    }

    const tflite::Model *model = tflite::GetModel(mlp_classifier_tflite);
    if (model->version() != TFLITE_SCHEMA_VERSION) {
        ESP_LOGE(TAG, "Unsupported TFLite schema version: %lu",
                 static_cast<unsigned long>(model->version()));
        return false;
    }

    static tflite::MicroMutableOpResolver<16> resolver;
    if (resolver.AddConv2D() != kTfLiteOk ||
        resolver.AddDepthwiseConv2D() != kTfLiteOk ||
        resolver.AddFullyConnected() != kTfLiteOk ||
        resolver.AddMaxPool2D() != kTfLiteOk ||
        resolver.AddAveragePool2D() != kTfLiteOk ||
        resolver.AddReshape() != kTfLiteOk ||
        resolver.AddExpandDims() != kTfLiteOk ||
        resolver.AddSqueeze() != kTfLiteOk ||
        resolver.AddAdd() != kTfLiteOk ||
        resolver.AddMul() != kTfLiteOk ||
        resolver.AddRelu() != kTfLiteOk ||
        resolver.AddSoftmax() != kTfLiteOk ||
        resolver.AddQuantize() != kTfLiteOk ||
        resolver.AddMean() != kTfLiteOk ||
        resolver.AddDequantize() != kTfLiteOk) {
        ESP_LOGE(TAG, "Unable to register TFLite operators");
        return false;
    }

    static tflite::MicroInterpreter static_interpreter(
        model, resolver, tensor_arena, arena_size);
    if (static_interpreter.AllocateTensors() != kTfLiteOk) {
        ESP_LOGE(TAG, "AllocateTensors failed");
        return false;
    }

    interpreter = &static_interpreter;
    input_tensor = interpreter->input(0);
    output_tensor = interpreter->output(0);

    ESP_LOGI(TAG, "Model size: %u bytes, arena used: %u / %u bytes",
             static_cast<unsigned>(sizeof(mlp_classifier_tflite)),
             static_cast<unsigned>(interpreter->arena_used_bytes()),
             static_cast<unsigned>(arena_size));
    return true;
}

int classify(const float *beat, const float *rr)
{
    if (interpreter == nullptr) {
        ESP_LOGE(TAG, "TFLite model is not initialized");
        return -1;
    }

    float features[kFeatureCount];
    extract_features(beat, features);
    for (int i = 0; i < kRrFeatures; ++i) {
        features[kMorphologyFeatures + i] = rr[i];
    }

    // Same StandardScaler as in training (mlp_classifier.py), applied
    // before quantizing so every feature uses the int8 range.
    for (int i = 0; i < kFeatureCount; ++i) {
        features[i] = (features[i] - mlp_scaler_mean[i]) / mlp_scaler_scale[i];
    }

    if (input_tensor->type == kTfLiteFloat32) {
        const int count = static_cast<int>(input_tensor->bytes / sizeof(float));
        std::memcpy(input_tensor->data.f, features,
                    std::min(count, kFeatureCount) * sizeof(float));
    } else if (input_tensor->type == kTfLiteInt8) {
        const int count = static_cast<int>(
            std::min(input_tensor->bytes, static_cast<size_t>(kFeatureCount)));
        const float scale = input_tensor->params.scale;
        const int zero_point = input_tensor->params.zero_point;
        for (int i = 0; i < count; ++i) {
            const long q = std::lround(features[i] / scale) + zero_point;
            input_tensor->data.int8[i] = static_cast<int8_t>(std::clamp(q, -128L, 127L));
        }
    } else {
        ESP_LOGE(TAG, "Unsupported TFLite input type: %d", input_tensor->type);
        return -1;
    }

    if (interpreter->Invoke() != kTfLiteOk) {
        ESP_LOGE(TAG, "TFLite Invoke failed");
        return -1;
    }

    int classes = kClassCount;
    if (output_tensor->type == kTfLiteFloat32) {
        classes = std::min(classes, static_cast<int>(output_tensor->bytes / sizeof(float)));
    } else if (output_tensor->type == kTfLiteInt8) {
        classes = std::min(classes, static_cast<int>(output_tensor->bytes));
    } else {
        ESP_LOGE(TAG, "Unsupported TFLite output type: %d", output_tensor->type);
        return -1;
    }

    int best = 0;
    float best_score = -INFINITY;
    for (int i = 0; i < classes; ++i) {
        const float score = (output_tensor->type == kTfLiteFloat32)
            ? output_tensor->data.f[i]
            : (output_tensor->data.int8[i] - output_tensor->params.zero_point) *
                  output_tensor->params.scale;
        if (score > best_score) {
            best_score = score;
            best = i;
        }
    }
    return best;
}

void print_model_info()
{
    std::printf("INFO,%s,%u,%u\n", kModelName,
                static_cast<unsigned>(sizeof(mlp_classifier_tflite)),
                interpreter != nullptr
                    ? static_cast<unsigned>(interpreter->arena_used_bytes())
                    : 0u);
    std::fflush(stdout);
}
